## config/boards/shields/totem/Kconfig.shield
```kconfig
# Copyright (c) 2022 The ZMK Contributors
# SPDX-License-Identifier: MIT

config SHIELD_TOTEM_CENTRAL_DONGLE
    def_bool $(shields_list_contains,totem_central_dongle)

config SHIELD_TOTEM_CENTRAL_LEFT
    def_bool $(shields_list_contains,totem_central_left)
    
config SHIELD_TOTEM_PERIPHERAL_LEFT
    def_bool $(shields_list_contains,totem_peripheral_left)

config SHIELD_TOTEM_PERIPHERAL_RIGHT
    def_bool $(shields_list_contains,totem_peripheral_right)
```
